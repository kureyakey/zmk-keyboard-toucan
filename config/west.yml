## config/west.yml
```yaml
manifest:
  defaults:
    revision: v0.3
  remotes:
    - name: zmkfirmware
      url-base: https://github.com/zmkfirmware
    - name: petejohanson
      url-base: https://github.com/petejohanson/
    - name: caksoylar
      url-base: https://github.com/caksoylar
    - name: geeksville
      url-base: https://github.com/geeksville
    - name: kureyakey
      url-base: https://github.com/kureyakey
    - name: sekigon-gonnoc
      url-base: https://github.com/sekigon-gonnoc
      
  projects:
    - name: zmk
      remote: zmkfirmware
      import: app/west.yml
    - name: zmk-feature-non-lipo-battery-management
      remote: kureyakey
      revision: main
    - name: cirque-input-module
      remote: geeksville
      revision: toucan
    - name: zmk-rgbled-widget
      remote: caksoylar
      revision: v0.3
  self:
    path: config
```
